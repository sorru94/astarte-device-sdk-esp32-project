## sdkconfig.defaults
```kconfig
#
# Partition table
#
CONFIG_PARTITION_TABLE_CUSTOM=y
CONFIG_PARTITION_TABLE_CUSTOM_FILENAME="custom_partitions.csv"
CONFIG_PARTITION_TABLE_CUSTOM_APP_BIN_OFFSET=0x10000
CONFIG_PARTITION_TABLE_FILENAME="custom_partitions.csv"
CONFIG_APP_OFFSET=0x10000
CONFIG_ESPTOOLPY_FLASHSIZE_4MB=y
# end of Partition table

#
# Astarte SDK
#
CONFIG_ASTARTE_HWID_ENABLE_UUID=n
CONFIG_ASTARTE_HWID_UUID_NAMESPACE=""
# end of Astarte SDK
```
